## drivers/clk/realtek/Kconfig
```kconfig
# SPDX-License-Identifier: GPL-2.0-only
config CLK_RTD129X_SCPU
	tristate "Realtek RTD129x SCPU (CPU) PLL clock"
	depends on ARCH_REALTEK || COMPILE_TEST
	depends on MFD_SYSCON
	help
	  This enables the CPU PLL clock driver for Realtek RTD129x SoCs,
	  needed for CPU frequency scaling (cpufreq-dt).

config CLK_RTD129X_GATE
	bool "Realtek RTD129x clock gate controllers"
	depends on ARCH_REALTEK || COMPILE_TEST
	default ARCH_REALTEK
	help
	  This enables the clock gate controllers found in the CRT and ISO
	  register blocks of Realtek RTD129x SoCs.  SATA, PCIe, I2C and the
	  other peripherals cannot be brought out of reset without them.
```

## drivers/phy/realtek/Kconfig
```kconfig
# SPDX-License-Identifier: GPL-2.0
#
# Phy drivers for Realtek platforms
#

if ARCH_REALTEK || COMPILE_TEST

config PHY_RTK_RTD_USB2PHY
	tristate "Realtek RTD USB2 PHY Transceiver Driver"
	depends on USB_SUPPORT
	select GENERIC_PHY
	select USB_PHY
	select USB_COMMON
	help
	  Enable this to support Realtek SoC USB2 phy transceiver.
	  The DHC (digital home center) RTD series SoCs used the Synopsys
	  DWC3 USB IP. This driver will do the PHY initialization
	  of the parameters.

config PHY_RTK_RTD_USB3PHY
	tristate "Realtek RTD USB3 PHY Transceiver Driver"
	depends on USB_SUPPORT
	select GENERIC_PHY
	select USB_PHY
	select USB_COMMON
	help
	  Enable this to support Realtek SoC USB3 phy transceiver.
	  The DHC (digital home center) RTD series SoCs used the Synopsys
	  DWC3 USB IP. This driver will do the PHY initialization
	  of the parameters.

config PHY_RTK_RTD_SATAPHY
	tristate "Realtek RTD129x SATA PHY (vendor)"
	select GENERIC_PHY
	help
	  Vendor-style SATA PHY driver for Realtek RTD129x.
	  This exists for bring-up to support SATA on WD My Cloud Home.

endif # ARCH_REALTEK || COMPILE_TEST
```
